## arch/arm/mach-dove/Kconfig
```kconfig
if ARCH_DOVE

menu "Marvell Dove Implementations"

config MACH_DOVE_DB
	bool "Marvell DB-MV88AP510 Development Board"
	select I2C_BOARDINFO
	help
	  Say 'Y' here if you want your kernel to support the
	  Marvell DB-MV88AP510 Development Board.

config MACH_CM_A510
	bool "CompuLab CM-A510 Board"
	help
	  Say 'Y' here if you want your kernel to support the
	  CompuLab CM-A510 Board.

config MACH_CUBOX
	bool "SolidRun CuBox"
	help
	  Say 'Y' here if you want your kernel to support the
	  SolidRun CuBox platform

config MACH_D2PLUG
	bool "Marvell D2Plug"
	help
	  Say 'Y' here if you want your kernel to support the
	  Marvell MV88AP510 based D2plug platform.

endmenu

endif
```

## drivers/net/wireless/mwifiex/Kconfig
```kconfig
config MWIFIEX
	tristate "Marvell WiFi-Ex Driver"
	depends on CFG80211
	select LIB80211
	---help---
	  This adds support for wireless adapters based on Marvell
	  802.11n chipsets.

	  If you choose to build it as a module, it will be called
	  mwifiex.

config MWIFIEX_ENABLE_AP_INTERFACE
	bool "Create WiFi-Ex Driver AP Network Interface"
	depends on MWIFIEX
	default n
	---help---
	  This option creates a AP network interface for marvell
	  wifi-ex driver. That interface will be named as uap.

	  Select this option if you want to create AP interface for
	  mwifiex driver.

config MWIFIEX_SDIO
	tristate "Marvell WiFi-Ex Driver for SD8786/SD8787/SD8797"
	depends on MWIFIEX && MMC
	select FW_LOADER
	---help---
	  This adds support for wireless adapters based on Marvell
	  8786/8787/8797 chipsets with SDIO interface.

	  If you choose to build it as a module, it will be called
	  mwifiex_sdio.

config MWIFIEX_PCIE
	tristate "Marvell WiFi-Ex Driver for PCIE 8766"
	depends on MWIFIEX && PCI
	select FW_LOADER
	---help---
	  This adds support for wireless adapters based on Marvell
	  8766 chipset with PCIe interface.

	  If you choose to build it as a module, it will be called
	  mwifiex_pcie.

config MWIFIEX_USB
	tristate "Marvell WiFi-Ex Driver for USB8797"
	depends on MWIFIEX && USB
	select FW_LOADER
	---help---
	  This adds support for wireless adapters based on Marvell
	  Avastar 88W8797 chipset with USB interface.

	  If you choose to build it as a module, it will be called
	  mwifiex_usb.
```

## sound/soc/kirkwood/Kconfig
```kconfig
config SND_KIRKWOOD_SOC
	tristate "SoC Audio for the Marvell Kirkwood and Dove chip"
	depends on ARCH_KIRKWOOD || ARCH_DOVE
	help
	  Say Y or M if you want to add support for codecs attached to
	  the Kirkwood I2S interface. You will also need to select the
	  audio interfaces to support below.

config SND_KIRKWOOD_SOC_I2S
	tristate

config SND_KIRKWOOD_SOC_MODE_SEL
	bool "Kirkwood/Dove Leagacy selection for I2S and S/PDIF"
	default y
	depends on SND_KIRKWOOD_SOC_I2S
	help
	  Say Y or N if you want to use legacy style selection of I2C and S/PDIF
	  modes for Kirkwood/Dove Audio controller.

config SND_KIRKWOOD_SOC_SPDIF
	tristate "SoC Audio support for Kirkwood generic S/PDIF"
	depends on SND_KIRKWOOD_SOC
	select SND_KIRKWOOD_SOC_I2S
	select SND_SOC_SPDIF
	help
	  Say Y if you want to add support for SoC audio on
	  generic S/PDIF.

config SND_KIRKWOOD_SOC_OPENRD
	tristate "SoC Audio support for Kirkwood Openrd Client"
	depends on SND_KIRKWOOD_SOC && (MACH_OPENRD_CLIENT || MACH_OPENRD_ULTIMATE)
	depends on I2C
	select SND_KIRKWOOD_SOC_I2S
	select SND_SOC_CS42L51
	help
	  Say Y if you want to add support for SoC audio on
	  Openrd Client.

config SND_KIRKWOOD_SOC_T5325
	tristate "SoC Audio support for HP t5325"
	depends on SND_KIRKWOOD_SOC && MACH_T5325 && I2C
	select SND_KIRKWOOD_SOC_I2S
	select SND_SOC_ALC5623
	help
	  Say Y if you want to add support for SoC audio on
	  the HP t5325 thin client.
```
